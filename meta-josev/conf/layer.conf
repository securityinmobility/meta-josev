## meta-josev/conf/layer.conf
```bitbake
# We have a conf and classes directory, add to BBPATH
BBPATH .= ":${LAYERDIR}"

# We have recipes-* directories, add to BBFILES
BBFILES += "${LAYERDIR}/recipes-*/*/*.bb \
            ${LAYERDIR}/recipes-*/*/*.bbappend"

BBFILE_COLLECTIONS += "meta-iso15118"
BBFILE_PATTERN_meta-iso15118 = "^${LAYERDIR}/"
BBFILE_PRIORITY_meta-iso15118 = "6"

LAYERDEPENDS_meta-iso15118 = "core"
LAYERSERIES_COMPAT_meta-iso15118 = "langdale mickledore"
```
